## board/alphascale/asm9260t-evk/Kconfig
```kconfig
if TARGET_ASM9260T_EVK

config SYS_CPU
	default "arm926ejs"

config SYS_BOARD
	default "asm9260t-evk"

config SYS_VENDOR
	default "alphascale"

config SYS_SOC
	default "as92"

config SYS_CONFIG_NAME
	default "asm9260t-evk"

endif
```
